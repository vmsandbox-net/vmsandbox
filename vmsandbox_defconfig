## vmsandbox_defconfig
```kconfig
# Minimal RISC-V 64-bit config for TinyEMU (VirtIO console + VirtIO block)
CONFIG_SYSVIPC=y
CONFIG_POSIX_MQUEUE=y
CONFIG_NO_HZ_IDLE=y
CONFIG_HIGH_RES_TIMERS=y
CONFIG_PREEMPT_NONE=y
CONFIG_IKCONFIG=y
CONFIG_LOG_BUF_SHIFT=14
CONFIG_CGROUPS=y
CONFIG_BLK_DEV_INITRD=y
CONFIG_EXPERT=y
CONFIG_SLAB=y
# Architecture
CONFIG_RISCV=y
CONFIG_64BIT=y
CONFIG_SMP=y
CONFIG_NR_CPUS=8
CONFIG_MMU=y
CONFIG_ARCH_RV64I=y
CONFIG_CMODEL_MEDANY=y
CONFIG_RISCV_ISA_C=y
CONFIG_FPU=y
CONFIG_RISCV_SBI=y
CONFIG_RISCV_SBI_V01=y
# Console — VirtIO console (hvc0); OpenSBI uses HTIF for its own output
# SBI earlycon gives early boot messages before hvc0 registers
CONFIG_TTY=y
CONFIG_VIRTIO_CONSOLE=y
CONFIG_SERIAL_EARLYCON_RISCV_SBI=y
CONFIG_PRINTK=y
# VirtIO devices (MMIO — TinyEMU uses MMIO not PCIe)
CONFIG_VIRTIO=y
CONFIG_VIRTIO_MENU=y
CONFIG_VIRTIO_MMIO=y
CONFIG_VIRTIO_BLK=y
CONFIG_NETDEVICES=y
CONFIG_VIRTIO_NET=y
# Block layer
CONFIG_BLOCK=y
CONFIG_BLK_MQ_VIRTIO=y
# VirtIO RNG
CONFIG_HW_RANDOM=y
CONFIG_HW_RANDOM_VIRTIO=y
# 9P / VirtIO filesystem
CONFIG_NET_9P=y
CONFIG_NET_9P_VIRTIO=y
CONFIG_9P_FS=y
# Filesystems
CONFIG_EXT4_FS=y
CONFIG_EXT4_USE_FOR_EXT2=y
CONFIG_PROC_FS=y
CONFIG_PROC_SYSCTL=y
CONFIG_SYSFS=y
CONFIG_TMPFS=y
CONFIG_DEVTMPFS=y
CONFIG_DEVTMPFS_MOUNT=y
# Networking (minimal)
CONFIG_NET=y
CONFIG_UNIX=y
CONFIG_INET=y
CONFIG_PACKET=y
# Binary formats
CONFIG_BINFMT_ELF=y
CONFIG_BINFMT_SCRIPT=y
# Device tree / OF
CONFIG_OF=y
CONFIG_OF_FLATTREE=y
CONFIG_OF_EARLY_FLATTREE=y
# RTC — Goldfish RTC provides wall-clock time to the guest
CONFIG_RTC_CLASS=y
CONFIG_RTC_HCTOSYS=y
CONFIG_RTC_HCTOSYS_DEVICE="rtc0"
CONFIG_RTC_INTF_SYSFS=y
CONFIG_RTC_INTF_PROC=y
CONFIG_RTC_INTF_DEV=y
CONFIG_RTC_DRV_GOLDFISH=y
# IRQ chip and timer
CONFIG_RISCV_INTC=y
CONFIG_SIFIVE_PLIC=y
CONFIG_RISCV_TIMER=y
CONFIG_HZ_250=y
# Memory
CONFIG_MEMORY_HOTPLUG=n
# No modules
CONFIG_MODULES=n
# No debug info to keep size down
CONFIG_DEBUG_KERNEL=n
CONFIG_DEBUG_INFO_NONE=y
```
